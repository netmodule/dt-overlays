/*
 * Copyright (C) 2012 Texas Instruments Incorporated - http://www.ti.com/
 *
 * This program is free software; you can redistribute it and/or modify
 * it under the terms of the GNU General Public License version 2 as
 * published by the Free Software Foundation.
 */
/dts-v1/;
/plugin/;

/ {
	compatible = "ti,am33xx";

	fragment@0 {	/* first child node */
		target-path = "/ocp/can@481cc000";	/* dcan0 phandle doesn't work */
		__overlay__ {
			status = "okay";
		};
	};

	fragment@1 {	/* first child node */
		target-path = "/ocp/can@481d0000";	/* dcan1 phandle doesn't work */
		__overlay__ {
			status = "okay";
		};
	};
};
